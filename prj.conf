## CMakeLists.txt
```
cmake_minimum_required(VERSION 3.20.0)
set(BOARD qemu_cortex_m3)

find_package(Zephyr)
project(zephyrtest)

include_directories(src)
file(GLOB_RECURSE SRCS src/*.cpp)
target_sources(app PRIVATE ${SRCS})
```

## prj.conf
```kconfig
CONFIG_CPLUSPLUS=y
CONFIG_NEWLIB_LIBC=y
CONFIG_LIB_CPLUSPLUS=y
CONFIG_NEWLIB_LIBC_FLOAT_PRINTF=y
CONFIG_SMF=y
```

## src/main.cpp
```c
#include <zephyr/kernel.h>
#include "controller/controller.hpp"
using namespace zephyrtest;

int main() {
    printk("Hello World! %s\n", CONFIG_BOARD);

    sm::StateMachine state_machine;
    controller::Controller controller(state_machine);
    controller.run();

    while(1) {
        k_msleep(1000);
    }
}
```
